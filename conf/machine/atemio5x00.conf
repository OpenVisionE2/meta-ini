## conf/machine/atemio5x00.conf
```bitbake
#
# This is config file for Atemio 5x00-HD
#

MTD_KERNEL = "mtd2"
MTD_ROOTFS = "mtd0"

include conf/machine/include/ini-oem.inc

PREFERRED_PROVIDER_virtual/kernel = "linux-ini-hde"
PREFERRED_VERSION_linux-ini-hde2 = "3.12.1"

IMAGEDIR = "atemio/5x00"

MACHINE_FEATURES += "videoenhancement singlecore extrasplash blindscan-tbs blindscan-dvbs"

SOC_FAMILY = "bcm7358"

UBI_VOLNAME = "rootfs"
MKUBIFS_ARGS = "-m 2048 -e 126976 -c 4096"
UBINIZE_ARGS = "-m 2048 -p 128KiB"

MACHINE_EXTRA_RRECOMMENDS += "\
    ini-cfe \
    "

MACHINE_ESSENTIAL_EXTRA_RDEPENDS += "\
    ini-dvb-modules-inihde \
    "
```

## conf/machine/atemio6100.conf
```bitbake
#
# This is config file for INI HDe2 HW
#

MTD_KERNEL = "mtd2"
MTD_ROOTFS = "mtd0"

include conf/machine/include/ini-oem.inc

PREFERRED_PROVIDER_virtual/kernel = "linux-ini-hde2"
PREFERRED_VERSION_linux-ini-hde2 = "3.14.2"

IMAGEDIR = "atemio/6100"

MACHINE_FEATURES += "videoenhancement singlecore extrasplash blindscan-tbs dvb-c dvbc-only"

SOC_FAMILY = "bcm7362"

UBI_VOLNAME = "rootfs"
MKUBIFS_ARGS = "-m 2048 -e 126976 -c 4096"
UBINIZE_ARGS = "-m 2048 -p 128KiB"

MACHINE_EXTRA_RRECOMMENDS += "\
    ini-cfe \
    "

MACHINE_ESSENTIAL_EXTRA_RDEPENDS = "\
    ini-dvb-modules-inihde2am \
    "
```

## conf/machine/atemionemesis.conf
```bitbake
#
# This is config file for Atemio Nemesis
#

require conf/machine/include/inihdp.inc

IMAGEDIR = "atemio/8x00"

MACHINE_ESSENTIAL_EXTRA_RDEPENDS += "\
	ini-dvb-modules-ini-800 \
	"

MACHINE_FEATURES += "bluetooth"

DISPLAY_BRAND = "Atemio"
DISPLAY_MODEL = "Nemesis"
```

## conf/machine/beyonwizt2.conf
```bitbake
#
# This is config file for Beyonwiz T2
#

require conf/machine/include/inihde2.inc

IMAGEDIR = "beyonwiz/hde2"

MACHINE_FEATURES += "dvb-c eDBoxLCD"

MACHINE_ESSENTIAL_EXTRA_RDEPENDS += "\
	ini-dvb-modules-inihde2au \
	"

RCNAME = "ini7"

DISPLAY_BRAND = "Beyonwiz"
DISPLAY_MODEL = "T2"
```

## conf/machine/beyonwizt3.conf
```bitbake
#
# This is config file for Beyonwiz T3
#

require conf/machine/include/inihdx.inc

IMAGEDIR = "beyonwiz/hdx"

MACHINE_FEATURES += "vfdsymbol"

RCNAME = "ini5"

DISPLAY_BRAND = "Beyonwiz"
DISPLAY_MODEL = "T3"
```

## conf/machine/beyonwizt4.conf
```bitbake
#
# This is config file for Beyonwiz T4
#

MTD_KERNEL = "mtd2"
MTD_ROOTFS = "mtd0"

include conf/machine/include/ini-oem.inc

PREFERRED_PROVIDER_virtual/kernel = "linux-ini-hdp"
PREFERRED_VERSION_linux-ini-hdp = "3.14.2"

IMAGEDIR ?= "beyonwiz/hdp"

MACHINE_FEATURES += "videoenhancement extrasplash blindscan-tbs dvb-c blindscan-dvbc blindscan-dvbs multitranscoding transcoding bwlcd255 fanctrl fan iniwol ci inibt"

SOC_FAMILY = "bcm7425"

UBI_VOLNAME = "rootfs"
MKUBIFS_ARGS = "-m 4096 -e 1040384 -c 1984"
UBINIZE_ARGS = "-m 4096 -p 1024KiB"

MACHINE_ESSENTIAL_EXTRA_RDEPENDS += "\
    ini-dvb-modules-ini-840t4 \
    ini-coldboot \
    ini-ethwol \
    rt8723bt \
    kernel-module-rtk-btusb \
    rtl8723a \
    kernel-module-8723au \
    rt3070 \
    firmware-rt3070 \
    "

MACHINE_EXTRA_RRECOMMENDS += "\
    ini-cfe \
    "
```

## conf/machine/include/inihde.inc
```bitbake
require conf/machine/include/ini-oem.inc

MTD_KERNEL = "mtd2"
MTD_ROOTFS = "mtd0"

PREFERRED_PROVIDER_virtual/kernel = "linux-ini-hde"
PREFERRED_VERSION_linux-ini-hde2 = "3.12.1"

MACHINE_FEATURES += "videoenhancement extrasplash blindscan-tbs blindscan-dvbs blindscan-dvbc dvb-c ci"

SOC_FAMILY = "bcm7358"

UBI_VOLNAME = "rootfs"
MKUBIFS_ARGS = "-m 2048 -e 126976 -c 4096"
UBINIZE_ARGS = "-m 2048 -p 128KiB"

MACHINE_EXTRA_RRECOMMENDS += "\
    ini-cfe \
    "

STB_PLATFORM = "inihde"
```

## conf/machine/include/inihde2.inc
```bitbake
require conf/machine/include/ini-oem.inc

MTD_KERNEL = "mtd2"
MTD_ROOTFS = "mtd0"

PREFERRED_PROVIDER_virtual/kernel = "linux-ini-hde2"
PREFERRED_VERSION_linux-ini-hde2 = "3.14.2"

MACHINE_FEATURES += "videoenhancement extrasplash blindscan-tbs YUV"

SOC_FAMILY = "bcm7362"

MKUBIFS_ARGS = "-m 2048 -e 126976 -c 4096"
UBINIZE_ARGS = "-m 2048 -p 128KiB"

MACHINE_EXTRA_RRECOMMENDS += "\
    ini-cfe \
    "

STB_PLATFORM = "inihde2"
```

## conf/machine/mbhybrid.conf
```bitbake
#
# This is config file for INI HDe2 HW
#

include conf/machine/include/ini-oem.inc

PREFERRED_PROVIDER_virtual/kernel = "linux-ini-hde2"
PREFERRED_VERSION_linux-ini-hde2 = "3.14.2"

IMAGEDIR = "miraclebox/minihybrid"

MACHINE_FEATURES += "videoenhancement singlecore extrasplash blindscan-tbs dvb-c dvb-c-only"

SOC_FAMILY = "bcm7362"

UBI_VOLNAME = "rootfs"
MKUBIFS_ARGS = "-m 2048 -e 126976 -c 4096"
UBINIZE_ARGS = "-m 2048 -p 128KiB"

MACHINE_EXTRA_RRECOMMENDS += "\
    ini-cfe \
    "

MACHINE_ESSENTIAL_EXTRA_RDEPENDS = "\
    ini-dvb-modules-inihde2sv \
    "
```

## conf/machine/mbtwin.conf
```bitbake
#
# This is config file for Miraclebox Premium Twin
#

require conf/machine/include/inihdx.inc

IMAGEDIR = "miraclebox/twin"

MACHINE_FEATURES += "vfdsymbol"

RCNAME = "ini3"

DISPLAY_BRAND = "Miraclebox"
DISPLAY_MODEL = "Premium Twin"
```

## conf/machine/mbultra.conf
```bitbake
#
# This is config file for Miraclebox Premium Ultra
#

require conf/machine/include/inihdp.inc

IMAGEDIR = "miraclebox/ultra"

MACHINE_ESSENTIAL_EXTRA_RDEPENDS += "\
	ini-dvb-modules-ini-800 \
	kernel-module-tuner-it913x \
	enigma2-plugin-drivers-dvb-usb-it913x \
	"

MACHINE_FEATURES += "bluetooth"

RCNAME = "ini3"

DISPLAY_BRAND = "Miraclebox"
DISPLAY_MODEL = "Premium Ultra"
```

## conf/machine/opticumtt.conf
```bitbake
#
# This is config file for Opticum Twin
#

MTD_KERNEL = "mtd2"
MTD_ROOTFS = "mtd0"

require conf/machine/include/ini-oem.inc

PREFERRED_PROVIDER_virtual/kernel = "linux-ini-hde2"
PREFERRED_VERSION_linux-ini-hde2 = "3.14.2"

IMAGEDIR = "opticum/tt"

MACHINE_FEATURES += "videoenhancement extrasplash blindscan-tbs dvb-c blindscan-dvbc blindscan-dvbs ci textlcd"

SOC_FAMILY = "bcm7362"

UBI_VOLNAME = "rootfs"
MKUBIFS_ARGS = "-m 2048 -e 126976 -c 4096"
UBINIZE_ARGS = "-m 2048 -p 128KiB"

MACHINE_EXTRA_RRECOMMENDS += "\
    ini-cfe \
    "

MACHINE_ESSENTIAL_EXTRA_RDEPENDS += "\
    ini-dvb-modules-ini-435oc \
    "
```

## conf/machine/sezam1000hd.conf
```bitbake
#
# This is config file for Sezam 1000HD
#

require conf/machine/include/inihde.inc

MACHINE_FEATURES += "textlcd"

IMAGEDIR = "hde"

MACHINE_ESSENTIAL_EXTRA_RDEPENDS += "\
    ini-dvb-modules-inihde \
    "
```

## conf/machine/sezam5000hd.conf
```bitbake
#
# This is config file for Sezam 5000HD
#

require conf/machine/include/inihdx.inc

IMAGEDIR = "hdx"

MACHINE_FEATURES += "vfdsymbol"

RCNAME = "ini2"

DISPLAY_BRAND = "Sezam"
DISPLAY_MODEL = "5000-HD"
```

## conf/machine/sezammarvel.conf
```bitbake
#
# This is config file for Sezam Marvel
#

require conf/machine/include/inihdp.inc

IMAGEDIR = "hdp"

MACHINE_ESSENTIAL_EXTRA_RDEPENDS += "\
	ini-dvb-modules-ini-900 \
	"

DISPLAY_BRAND = "Sezam"
DISPLAY_MODEL = "Marvel"
```

## conf/machine/ventonhdx.conf
```bitbake
#
# This is config file for Venton HDX
#

require conf/machine/include/inihdx.inc

IMAGEDIR = "venton-hdx"

RCNAME = "ini0"

DISPLAY_BRAND = "UNiBOX"
DISPLAY_MODEL = "HD-x"
```

## conf/machine/xpeedlx.conf
```bitbake
#
# This is config file for GI LX-x
#

require conf/machine/include/inihde.inc

MACHINE_FEATURES += "textlcd"

MACHINE_ESSENTIAL_EXTRA_RDEPENDS += "\
	ini-dvb-modules-inihde \
	"

DISPLAY_BRAND = "GI"
DISPLAY_MODEL = "LX-x"
```

## conf/machine/xpeedlx3.conf
```bitbake
#
# This is config file for GI LX-3
#

require conf/machine/include/inihdp.inc

MACHINE_ESSENTIAL_EXTRA_RDEPENDS += "\
	ini-dvb-modules-ini-900 \
	"

DISPLAY_BRAND = "GI"
DISPLAY_MODEL = "LX-3"
```

## conf/machine/xpeedlxpro.conf
```bitbake
#
# This is config file for INI HDe2 HW
#

include conf/machine/include/ini-oem.inc

PREFERRED_PROVIDER_virtual/kernel = "linux-ini-hde2"
PREFERRED_VERSION_linux-ini-hde2 = "3.14.2"

IMAGEDIR = "xpeedlxpro"

MACHINE_FEATURES += "videoenhancement singlecore extrasplash blindscan-tbs textlcd 7segment blindscan-dvbs forceflash"

SOC_FAMILY = "bcm7362"

UBI_VOLNAME = "rootfs"
MKUBIFS_ARGS = "-m 2048 -e 126976 -c 4096"
UBINIZE_ARGS = "-m 2048 -p 128KiB"

EXTRA_IMAGEDEPENDS += "\
    enigma2-plugin-systemplugins-micomupgrade \
    "

MACHINE_EXTRA_RDEPENDS = "\
    enigma2-plugin-systemplugins-micomupgrade \
    "

MACHINE_EXTRA_RRECOMMENDS += "\
    ini-cfe \
    "

MACHINE_ESSENTIAL_EXTRA_RDEPENDS = "\
    ini-dvb-modules- \
    "
```
